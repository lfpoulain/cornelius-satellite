## main/Kconfig.projbuild
```kconfig
menu "Satellite Cornelius"

    config SATELLITE_WIFI_SSID
        string "Wi-Fi : nom du réseau (2,4 GHz)"
        default ""

    config SATELLITE_WIFI_PASSWORD
        string "Wi-Fi : mot de passe"
        default ""

    config SATELLITE_SERVER_URI
        string "Adresse fixe de Cornelius (vide : trouvé par mDNS)"
        default ""
        help
            Laisser vide : le satellite trouve Cornelius sur le réseau local (mDNS,
            _cornelius._tcp). Sinon, wss://<adresse>:3443/satellite ; si cette adresse ne
            répond plus pendant 30 s, le satellite cherche aussi Cornelius par mDNS.

    config SATELLITE_SERVER_KEY_SHA256
        string "Empreinte de la clé de Cornelius (SHA-256)"
        default ""
        help
            Empreinte de la clé publique de Cornelius, 32 octets en hexadécimal séparés par
            des deux-points, affichée dans Administration → Satellites audio. Le satellite ne
            se connecte qu'au serveur qui détient cette clé ; elle ne change pas quand
            Cornelius renouvelle son certificat.

    config SATELLITE_TOKEN
        string "Jeton du satellite"
        default ""
        help
            Jeton montré une seule fois dans Administration → Satellites audio.

    config SATELLITE_MIC_GAIN_DB
        int "Gain du micro (dB)"
        range 0 37
        default 30

    config SATELLITE_LED_COUNT
        int "Nombre de LED de l'anneau"
        range 1 16
        default 7

    config SATELLITE_AEC
        bool "Annulation d'écho (écoute attentive)"
        default y
        help
            Lit la référence du haut-parleur (voie 2 de l'ES7210) et retire l'écho du micro
            avec ESP-SR ; le satellite l'annonce (aec) et, si l'écoute attentive est activée
            dans l'administration, Cornelius garde le micro ouvert pendant qu'il parle.
            Désactivée : semi-duplex, le micro est coupé pendant que Cornelius parle.

    config SATELLITE_GESTURES
        bool "Capteur de gestes PAJ7620 optionnel (I2C 0x73)"
        default n
        help
            Activer uniquement si un PAJ7620 est installé sur SDA11/SCL10.
            Sans capteur, l'audio reste disponible et aucun geste n'est annoncé.
endmenu
```
